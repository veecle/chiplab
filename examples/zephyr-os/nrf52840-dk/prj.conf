## CMakeLists.txt
```
# SPDX-License-Identifier: MIT
cmake_minimum_required(VERSION 3.20.0)

find_package(Zephyr REQUIRED HINTS $ENV{ZEPHYR_BASE})
project(hello-nrf52840-dk)

target_sources(app PRIVATE src/main.c)
```

## west.yml
```
# T2 ("application is the manifest repo") topology: this directory IS the west
# manifest. `west init -l .` here, then `west update` pulls Zephyr + its modules
# (hal_nordic, …) into the workspace alongside it. Only the files in this folder are
# committed; the pulled trees are gitignored (see the repo-root .gitignore).
manifest:
  remotes:
    - name: zephyrproject-rtos
      url-base: https://github.com/zephyrproject-rtos

  projects:
    - name: zephyr
      remote: zephyrproject-rtos
      revision: v4.4.1
      # Import Zephyr's own manifest so its HAL modules and deps come along.
      import: true

  self:
    path: .
```

## prj.conf
```kconfig
# The nrf52840dk/nrf52840 board defconfig already enables the UART console
# (CONFIG_SERIAL/CONFIG_CONSOLE/CONFIG_UART_CONSOLE) with zephyr,console = &uart0,
# which Chiplab captures. Nothing to add for a plain printf() hello world.
```

## src/main.c
```c
/* nRF52840 DK: print "Hello world!" over the default Zephyr console (uart0). */

#include <stdio.h>

int main(void)
{
	printf("Hello world!\n");
	return 0;
}
```
