## CMakeLists.txt
```
# SPDX-License-Identifier: MIT
cmake_minimum_required(VERSION 3.20.0)

find_package(Zephyr REQUIRED HINTS $ENV{ZEPHYR_BASE})
project(hello-stm32f7-discovery)

target_sources(app PRIVATE src/main.c)
```

## prj.conf
```kconfig
# The stm32f746g_disco board defconfig already enables the UART console
# (CONFIG_SERIAL/CONFIG_CONSOLE/CONFIG_UART_CONSOLE) with zephyr,console = &usart1,
# which Chiplab captures. Nothing to add for a plain printf() hello world.
```

## src/main.c
```c
/* STM32F7 Discovery: print "Hello world!" over the default Zephyr console (usart1). */

#include <stdio.h>

int main(void)
{
	printf("Hello world!\n");
	return 0;
}
```
