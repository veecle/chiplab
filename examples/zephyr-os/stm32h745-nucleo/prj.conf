## CMakeLists.txt
```
# SPDX-License-Identifier: MIT
cmake_minimum_required(VERSION 3.20.0)

find_package(Zephyr REQUIRED HINTS $ENV{ZEPHYR_BASE})
project(hello-stm32h745-nucleo)

target_sources(app PRIVATE src/main.c)
```

## prj.conf
```kconfig
# The nucleo_h745zi_q/stm32h745xx/m7 board defconfig already enables the UART
# console (CONFIG_SERIAL/CONFIG_CONSOLE/CONFIG_UART_CONSOLE) with
# zephyr,console = &usart3, which Chiplab captures. Nothing to add for a plain
# printf() hello world.
```

## src/main.c
```c
/* STM32H745 Nucleo (Cortex-M7 core): print "Hello world!" over the default Zephyr
 * console (usart3).
 */

#include <stdio.h>

int main(void)
{
	printf("Hello world!\n");
	return 0;
}
```
